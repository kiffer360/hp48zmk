/*
 * TrackPoint behaviors and settings.
 * Adapted from infused-kim's example zmk-config (config/include/mouse_tp.dtsi).
 *
 * Requires in the keymap, BEFORE this file is included:
 *   #define HAS_MOUSE_TP
 *   #define MOUSE_TP <index of the layer that turns on while the stick moves>
 */

#ifdef HAS_MOUSE_TP

#include <dt-bindings/zmk/mouse.h>
#include <dt-bindings/zmk/mouse_settings.h>
#include <behaviors/mouse_keys.dtsi>
#include <behaviors/mouse_setting.dtsi>

/*
 * Key behaviors that adjust TrackPoint settings at run time (no reflash).
 * Values are saved to flash 60 seconds after the last change.
 */
#define U_MSS_TP_S_I  &mms MS_TP_SENSITIVITY_INCR
#define U_MSS_TP_S_D  &mms MS_TP_SENSITIVITY_DECR
#define U_MSS_TP_V6_I &mms MS_TP_VALUE6_INCR
#define U_MSS_TP_V6_D &mms MS_TP_VALUE6_DECR
#define U_MSS_TP_NI_I &mms MS_TP_NEG_INERTIA_INCR
#define U_MSS_TP_NI_D &mms MS_TP_NEG_INERTIA_DECR
#define U_MSS_TP_PT_I &mms MS_TP_PTS_THRESHOLD_INCR
#define U_MSS_TP_PT_D &mms MS_TP_PTS_THRESHOLD_DECR
// Clears saved settings and restores the TrackPoint defaults
#define U_MSS_RESET   &mms MS_RESET
// Prints the current settings to the USB log so you can hard-code them below
#define U_MSS_LOG     &mms MS_LOG

#ifdef MOUSE_PS2_DT_PRESENT

&mouse_ps2_input_listener {
     xy-swap;
     x-invert;
    // y-invert;

    // Layer that turns on automatically while the stick is moving
    layer-toggle = <MOUSE_TP>;
    layer-toggle-delay-ms = <250>;
    layer-toggle-timeout-ms = <250>;
};

&mouse_ps2 {
    // tp-sensitivity = <128>;
    // tp-val6-upper-speed = <97>;
    // tp-neg-inertia = <6>;
    // tp-press-to-select;
    // tp-press-to-select-threshold = <10>;
    // tp-xy-swap;
    // tp-x-invert;
    // tp-y-invert;
    // sampling-rate = <60>;   // allowed: 10,20,40,60,80,100,200
    // disable-clicking;
    // scroll-mode;
};

// Enable the PS/2 devices (they are "disabled" in the shield overlay)
&mouse_ps2 {
    status = "okay";
};

&mouse_ps2_input_listener {
    status = "okay";
};

#ifdef MOUSE_PS2_DRIVER_UART
&uart0 {
    status = "okay";
};

&uart_ps2 {
    status = "okay";
};
#else
&gpio_ps2 {
    status = "okay";
};
#endif // MOUSE_PS2_DRIVER_UART

#endif // MOUSE_PS2_DT_PRESENT

#endif // HAS_MOUSE_TP
